VERSION ""

NS_ :

BS_:

BU_: Gateway Diagnostics

BO_ 100 DIAG_RESPONSE: 8 Diagnostics
 SG_ Mode M : 0|8@1+ (1,0) [0|15] "" Vector__XXX
 SG_ SubMode m1M : 8|8@1+ (1,0) [0|15] "" Vector__XXX
 SG_ PackVoltage m1 : 16|16@1+ (0.001,0) [0|60] "V" Vector__XXX
 SG_ FaultCount m1 : 16|8@1+ (1,0) [0|255] "" Vector__XXX
 SG_ Temperature m2 : 16|16@1- (0.1,0) [-40|215] "degC" Vector__XXX
 SG_ SerialNumber m3 : 16|32@1+ (1,0) [0|4294967295] "" Vector__XXX

BO_ 200 GATEWAY_STATUS: 4 Gateway
 SG_ Uptime : 0|24@1+ (1,0) [0|16777215] "s" Vector__XXX
 SG_ LinkUp : 24|1@1+ (1,0) [0|1] "" Vector__XXX

CM_ BU_ Diagnostics "Diagnostic responder";
CM_ BO_ 100 "Extended-multiplexed diagnostic response";
CM_ SG_ 100 Mode "Top-level response selector";
CM_ SG_ 100 SubMode "Nested selector, present only while Mode is 1";
CM_ SG_ 100 Temperature "Reported for several disjoint Mode values";

VAL_ 100 Mode 1 "Measurements" 2 "Thermal" 3 "Identity" ;
VAL_ 200 LinkUp 0 "Down" 1 "Up" ;

SG_MUL_VAL_ 100 SubMode Mode 1-1;
SG_MUL_VAL_ 100 PackVoltage SubMode 0-3;
SG_MUL_VAL_ 100 FaultCount SubMode 4-4, 9-11;
SG_MUL_VAL_ 100 Temperature Mode 2-2, 5-7;
SG_MUL_VAL_ 100 SerialNumber Mode 3-3;
