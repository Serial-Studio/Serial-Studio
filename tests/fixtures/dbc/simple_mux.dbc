VERSION ""

NS_ :

BS_:

BU_: Sensors Gateway

BO_ 768 SENSOR_MUX: 8 Sensors
 SG_ Channel M : 0|8@1+ (1,0) [0|3] "" Vector__XXX
 SG_ Timestamp : 48|16@1+ (1,0) [0|65535] "ms" Vector__XXX
 SG_ ChannelVoltage m0 : 8|16@1+ (0.1,0) [0|500] "V" Vector__XXX
 SG_ ChannelCurrent m1 : 8|16@1+ (0.1,0) [0|500] "A" Vector__XXX
 SG_ ChannelTemp m2 : 8|16@1- (0.5,0) [-100|100] "degC" Vector__XXX

BO_ 769 GATEWAY_STATUS: 4 Gateway
 SG_ Uptime : 0|24@1+ (1,0) [0|16777215] "s" Vector__XXX
 SG_ LinkUp : 24|1@1+ (1,0) [0|1] "" Vector__XXX

CM_ BU_ Sensors "Analog front end";
CM_ BO_ 768 "Round-robin analog channel, selected by Channel";
CM_ SG_ 768 Channel "Selects which measurement rides in bytes 1-2";
CM_ SG_ 769 LinkUp "Gateway link state";

VAL_ 768 Channel 0 "Voltage" 1 "Current" 2 "Temperature" ;
VAL_ 769 LinkUp 0 "Down" 1 "Up" ;
